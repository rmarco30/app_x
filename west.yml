## west.yml
```yaml
manifest:
  # lowest version of the manifest file schema that can parse this file’s data
  version: 0.8

  projects:
    - name: app_eric
      url: https://github.com/rmarco30/app_eric
      revision: master
      # import only zephyr and cmsis in app_eric's west.yml (technically in zephyr's west.yml file) file
      # good for filtering only the required imports needed by app_x
      import:
        name-allowlist:
          - zephyr
          - cmsis

  # Settings applied using the self key will only be applied to the manifest repository
  self:
    path: app_x
```
